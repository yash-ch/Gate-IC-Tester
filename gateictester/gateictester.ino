#include <Wire.h>
#include <Adafruit_GFX.h>
#include <Adafruit_SSD1306.h>

#define SCREEN_WIDTH 128 // OLED display width, in pixels
#define SCREEN_HEIGHT 64 // OLED display height, in pixels

// Declaration for an SSD1306 display connected to I2C (SDA, SCL pins)
Adafruit_SSD1306 display(SCREEN_WIDTH, SCREEN_HEIGHT, &Wire, -1);

static const unsigned char PROGMEM title_array[] = {
    0x00, 0x00, 0x00, 0x00, 0x00, 0x00, 0x00, 0x00, 0x00, 0x00, 0x00, 0x00, 0x00, 0x00, 0x00, 0x00,
    0x00, 0x06, 0x04, 0x00, 0x00, 0x00, 0x40, 0x00, 0x02, 0x00, 0x30, 0x00, 0x00, 0x00, 0x00, 0x00,
    0x00, 0x1f, 0x8e, 0x3f, 0x7c, 0x39, 0xf0, 0x18, 0x0f, 0x7e, 0xfc, 0xe3, 0x3e, 0xe3, 0x7e, 0x00,
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    0x00, 0x00, 0x00, 0x00, 0x00, 0x00, 0x00, 0x00, 0x00, 0x00, 0x00, 0x00, 0x00, 0x00, 0x00, 0x00};

static const unsigned char PROGMEM QR_Code_array[] = {
    0xff, 0xff, 0xff, 0xff, 0xff, 0xff, 0xff, 0xff, 0xff, 0xff, 0xff, 0xff, 0xff, 0xff, 0xff, 0xff,
    0xff, 0xff, 0xff, 0xff, 0xff, 0xff, 0xff, 0xff, 0xff, 0xff, 0xff, 0xff, 0xff, 0xff, 0xff, 0xff,
    0xff, 0xff, 0xff, 0xff, 0x80, 0x00, 0xc3, 0xff, 0xc0, 0x0c, 0x00, 0x07, 0xff, 0xff, 0xff, 0xff,
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    0xff, 0xff, 0xff, 0xff, 0xff, 0xff, 0xff, 0xff, 0xff, 0xff, 0xff, 0xff, 0xff, 0xff, 0xff, 0xff};

bool isTitleScreenButtonPressed = false;
int pointer = 0;
int menuStartIndex = 0;
int selectedOption = -1;

int segmentPointer = 0;
int segmentSelected = -1;

static const String menu_array[] = {
    "1. Test 14 Pin Gate     IC",
    "2. Test 555 Timer       IC",
    "3. Test 7 Segment       Display",
    "4. About This Project",
};

// String seven_segment_array[] = {
//    "1. Common Cathode",
//    "2. Common Anode",
// };

void setup()
{
  Serial.begin(115200);

  
  if (!display.begin(SSD1306_SWITCHCAPVCC, 0x3C))
  {
    for (;;)
      ;
  }
  delay(2000);
  display.clearDisplay();

  display.setTextSize(1);
  display.setTextColor(WHITE);

  // Display Title Image
  display.drawBitmap(0, 5, title_array, 128, 64, 1);
  display.display();
}

int menu(int resistorValue)
{
  display.setTextSize(2);
  display.setCursor(0, 0);
  display.print("Menu");
  int gap = 20;
  display.setTextSize(1);
  for (int i = menuStartIndex; i < 4; i++)
  {
    if (i == menuStartIndex)
    {
      display.setCursor(0, 20);
    }
    else if (menu_array[i - 1].length() > 21)
    {
      gap += 20;
    }
    else if (menu_array[i - 1].length() + 2 > 21 && i - 1 == pointer)
    {
      gap += 20;
    }
    else
    {
      gap += 12;
    }
    
    display.setCursor(0, gap);

    if (pointer == i)
    {
      display.print("> ");
    }
    // else
    // {
    //   display.setCursor(12, gap);
    // }
    
    
    display.print(menu_array[i]);
    display.display();
  }
  // if (resistorValue > 450 && resistorValue < 460 && pointer > 0)
  if (resistorValue > 15 && resistorValue < 22 && pointer > 0)
  {
    pointer--;
    display.clearDisplay();
    delay(100);
  }
  // else if (resistorValue > 505 && resistorValue < 515 && pointer < 3)
  else if (resistorValue > 8 && resistorValue <15 && pointer < 3)
  {
    pointer++;
    display.clearDisplay();
    delay(100);
  }
  // else if (resistorValue > 695 && resistorValue < 705)
  else if (resistorValue > 4 && resistorValue < 8)
  {
    return pointer;
  }

  if (pointer > 1)
  {
    menuStartIndex = pointer-1;
  }
  else if (pointer < menuStartIndex)
  {
    menuStartIndex = pointer;
  }

  return -1;
}

int sevenSegmentDisplay(int rv)
{
  display.clearDisplay();
  display.setTextSize(1);
  display.setCursor(0, 0);
  display.print("< 7 Segment Display");

  display.setCursor(0, 16);

  if (segmentPointer == 0)
  {
    display.print("> ");
  }
  else
  {
    display.setCursor(12, 16);
  }

  display.print("1. Common Anode");

  display.setCursor(0, 28);

  if (segmentPointer == 1)
  {
    display.print("> ");
  }
  else
  {
    display.setCursor(12, 28);
  }

  display.print("2. Common Cathode");
  display.display();

  // if (rv > 450 && rv < 460 && segmentPointer > 0)
  if (rv == 19 && segmentPointer > 0)
  {
    segmentPointer--;
    display.clearDisplay();
    delay(100);
  }
  // else if (rv > 505 && rv < 515 && segmentPointer < 1)
  else if (rv == 11 && segmentPointer < 1)
  {
    segmentPointer++;
    display.clearDisplay();
    delay(100);
  }
  // else if (rv > 695 && rv < 705)
  else if (rv == 6)
  {
    return segmentPointer;
  }
}

void loop()
{

  int resistorValue = analogRead(A0);
  if (resistorValue > 5 && isTitleScreenButtonPressed == false)
  {
    isTitleScreenButtonPressed = true;
    display.clearDisplay();
    display.setCursor(0, 23);
    display.setTextSize(2);
    display.println("Welcome :)");
    display.display();
    delay(500);
    display.clearDisplay();
  }
  if (isTitleScreenButtonPressed == true)
  {
    // segmentSelected = sevenSegmentDisplay(resistorValue);

    if (selectedOption == -1)
    {
      selectedOption = menu(resistorValue);
    }
    else if (selectedOption == 2)
    {
      segmentSelected = sevenSegmentDisplay(resistorValue);
    }
    else if (selectedOption == 3)
    {
      display.clearDisplay();
      display.drawBitmap(0, 0, QR_Code_array, 128, 64, 1);
      display.display();
    }

    // if (resistorValue > 735 && resistorValue < 747)
    if (resistorValue > 22 && resistorValue < 26)
    {
      selectedOption = -1;
      display.clearDisplay();
      delay(100);
    }
  }
}

// up button 450-460
// down button 505-515
// left button 735-747
// right button 695-705

// 7 Segment pinout
// 8 for transistor
// 13-6 pins and 0-1

//testing
//24 19 11 6